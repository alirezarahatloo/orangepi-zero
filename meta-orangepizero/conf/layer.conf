## meta-orangepizero/conf/layer.conf
```bitbake
# We have a conf and classes directory, add to BBPATH
BBPATH .= ":${LAYERDIR}"

# We have recipes-* directories, add to BBFILES
BBFILES += "${LAYERDIR}/recipes-*/*/*.bb \
            ${LAYERDIR}/recipes-*/*/*.bbappend"

BBFILE_COLLECTIONS += "meta-orangepizero"
BBFILE_PATTERN_meta-orangepizero = "^${LAYERDIR}/"
BBFILE_PRIORITY_meta-orangepizero = "6"

LAYERDEPENDS_meta-orangepizero = "core"
LAYERSERIES_COMPAT_meta-orangepizero = "dunfell"
```
